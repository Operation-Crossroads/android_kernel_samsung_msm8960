## drivers/video/msm/mhl_v2/Kconfig
```kconfig
# mhl drivers configuration
# driver/video/msm/mhl_v2/Kconfig
# Copyright (c) 2011 Samsung Electronics Co., Ltd.
#	 http://www.samsung.com

menu "Mhl(sii8240) device support"

config VIDEO_MHL_V2
	bool "Samsung Mobile HD Link Interface"
	depends on MSM_VIDC && ARCH_MSM
	default n
	---help---
	Support for MHL version2 driver. This is a new version of
	mhl which has the required functionality to support mhl 2.0 spec
	required.
	Say Y here if this support mhl_version2

config MHL_NEW_CBUS_MSC_CMD
	bool "Read DCAP for distinguish TA and USB"
	default n
	---help---
	If device support mhl version2, this feature should be Y here.
	To distinguish TA and USB charger, mhl_version2 support new msc cmd
	different from mhl_v1.

config MHL_D3_SUPPORT
	bool "Support D3 mode in mhl"
	default n
	---help---
	Power saving mode of MHL chip
endmenu
```
